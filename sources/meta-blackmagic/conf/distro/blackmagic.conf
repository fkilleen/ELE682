## sources/meta-blackmagic/conf/distro/blackmagic.conf
```bitbake
require conf/distro/poky.conf

MAINTAINER = "Shan Meunier Bernard & Francois Killeen"    

DISTRO = "blackmagic"      
DISTRO_NAME = "BlackMagic Distribution"      
DISTRO_VERSION = "0.1.0"      
DISTRO_CODENAME = "blackmagic"      
DISTRO_FEATURES_append = " systemd"  
SDK_VENDOR = "-blackmagic-sdk"      
SDK_VERSION := "${@'${DISTRO_VERSION}'.replace('snapshot-${DATE}','snapshot')}"     
PREFERRED_PROVIDER_virtual/kernel = "linux-stable"
PREFERRED_VERSION_linux-stable= "4.9%" 
```

## sources/meta-blackmagic/conf/layer.conf
```bitbake
# We have a conf and classes directory, add to BBPATH
BBPATH .= ":${LAYERDIR}"

# We have recipes-* directories, add to BBFILES
BBFILES += "${LAYERDIR}/recipes-*/*/*.bb \
            ${LAYERDIR}/recipes-*/*/*.bbappend \
            ${LAYERDIR}/images/*.bb"

BBFILE_COLLECTIONS += "meta-blackmagic"
BBFILE_PATTERN_meta-blackmagic = "^${LAYERDIR}/"
BBFILE_PRIORITY_meta-blackmagic = "20"

LAYERDEPENDS_meta-blackmagic = "core"
LAYERSERIES_COMPAT_meta-blackmagic = "thud"
```
